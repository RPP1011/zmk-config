/*
 * Copyright (c) 2020 ZMK Contributors
 *
 * SPDX-License-Identifier: MIT
 */

#include "skeletyl.dtsi"

&default_transform {
	col-offset = <5>;
};

&kscan0 {
  row-gpios = <&gpio0 2  (GPIO_ACTIVE_HIGH | GPIO_PULL_DOWN)>,
              <&gpio1 15 (GPIO_ACTIVE_HIGH | GPIO_PULL_DOWN)>,
              <&gpio1 13 (GPIO_ACTIVE_HIGH | GPIO_PULL_DOWN)>,
              <&gpio1 11 (GPIO_ACTIVE_HIGH | GPIO_PULL_DOWN)>;

  col-gpios = <&gpio0 11 (GPIO_ACTIVE_HIGH | GPIO_PULL_DOWN)>,
              <&gpio1 0  (GPIO_ACTIVE_HIGH | GPIO_PULL_DOWN)>,
              <&gpio0 24 (GPIO_ACTIVE_HIGH | GPIO_PULL_DOWN)>,
              <&gpio0 22 (GPIO_ACTIVE_HIGH | GPIO_PULL_DOWN)>,
              <&gpio0 20 (GPIO_ACTIVE_HIGH | GPIO_PULL_DOWN)>;
};
