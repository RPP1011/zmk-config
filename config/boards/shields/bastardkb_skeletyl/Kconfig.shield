## config/boards/shields/bastardkb_skeletyl/Kconfig.shield
```kconfig
config SHIELD_BASTARDKB_SKELETYL_LEFT
    def_bool $(shields_list_contains,bastardkb_skeletyl_left)

config SHIELD_BASTARDKB_SKELETYL_RIGHT
    def_bool $(shields_list_contains,bastardkb_skeletyl_right)
```
